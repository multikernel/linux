## Documentation/devicetree/bindings/virtio/multikernel,virtio.yaml
```yaml
# SPDX-License-Identifier: (GPL-2.0-only OR BSD-2-Clause)
%YAML 1.2
---
$id: http://devicetree.org/schemas/virtio/multikernel,virtio.yaml#
$schema: http://devicetree.org/meta-schemas/core.yaml#

title: Virtio device over multikernel shared memory

maintainers:
  - Cong Wang <xiyou.wangcong@gmail.com>

description:
  A virtio device served by another kernel on the same machine. The node
  points at the device's entry in a shared device table that carries
  feature negotiation, config space, and virtqueue addresses. Kicks and
  calls are pending bits in the entry plus the multikernel IPI.

properties:
  compatible:
    const: multikernel,virtio

  reg:
    maxItems: 1
    description: The device's entry in the shared table.

  multikernel,table:
    $ref: /schemas/types.yaml#/definitions/uint64
    description: Physical address of the shared table header.

required:
  - compatible
  - reg
  - multikernel,table

additionalProperties: false

examples:
  - |
    virtio@59a09000 {
        compatible = "multikernel,virtio";
        reg = <0x0 0x59a09000 0x0 0x400>;
        multikernel,table = /bits/ 64 <0x59a08000>;
    };
```
